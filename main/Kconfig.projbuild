## main/Kconfig.projbuild
```kconfig
menu "Homekit Configuration"

    config EXAMPLE_USE_HARDCODED_SETUP_CODE
        bool "Use hard-coded setup code"
        default y
        help
            HomeKit does not recommend having the setup code programmed in the accessory as is.
            Instead, it expects setup info (salt-verifier pair) generated for the given setup code.
            Use this option only for testing purposes. For production, the setup info should be
            used.

    config EXAMPLE_SETUP_CODE
        string "HomeKit Setup Code"
        default "111-22-333"
        depends on EXAMPLE_USE_HARDCODED_SETUP_CODE
        help
            Setup code to be used for HomeKot pairing, if hard-coded setup code is enabled.

    config EXAMPLE_SETUP_ID
        string "HomeKit Setup Id"
        default "ES32"
        depends on EXAMPLE_USE_HARDCODED_SETUP_CODE
        help
            Setup id to be used for Homekit pairing, if hard-coded setup code is enabled.

endmenu

menu "Time Configuration"
    config NTP_SERVER_NAME
        string "NTP Server"
        default "ntp1.sp.se"
        help
            NTP server to be used for setting local time

    config NTP_SERVER_TIMEOUT
        int "Timeout"
        default 2000
        help
            Timeout in seconds for setting time via NTP
endmenu
```
